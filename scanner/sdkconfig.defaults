## scanner/sdkconfig.defaults
```kconfig
CONFIG_ESP_MAIN_TASK_STACK_SIZE=30000
CONFIG_ESP_SYSTEM_EVENT_TASK_STACK_SIZE=4096
CONFIG_FREERTOS_IDLE_TASK_STACKSIZE=4096
CONFIG_PTHREAD_TASK_STACK_SIZE_DEFAULT=4096

# Always calibrate RF at boot; cached calibration has caused WPA2 handshake failures.
# CONFIG_ESP_PHY_CALIBRATION_AND_DATA_STORAGE is not set

CONFIG_ESP32S3_SPIRAM_SUPPORT=y
CONFIG_SPIRAM_MODE_OCT=y
CONFIG_SPIRAM_SPEED_80M=y
CONFIG_SPIRAM_TYPE_ESP32S3=y
CONFIG_SPIRAM_SIZE=8388608
CONFIG_SPIRAM_USE_MALLOC=1
CONFIG_SPIRAM_MALLOC_ALWAYSINTERNAL=4096

CONFIG_SCCB_HARDWARE_I2C_DRIVER_LEGACY=y
# CONFIG_SCCB_HARDWARE_I2C_DRIVER_NEW is not set
```

## viewer/sdkconfig.defaults
```kconfig
CONFIG_ESP_MAIN_TASK_STACK_SIZE=49152
CONFIG_ESP_SYSTEM_EVENT_TASK_STACK_SIZE=4096
CONFIG_FREERTOS_IDLE_TASK_STACKSIZE=4096
CONFIG_PTHREAD_TASK_STACK_SIZE_DEFAULT=4096

# CONFIG_MBEDTLS_HARDWARE_SHA is not set

# Always calibrate RF at boot; cached calibration can break WPA2 handshakes.
# CONFIG_ESP_PHY_CALIBRATION_AND_DATA_STORAGE is not set

CONFIG_MBEDTLS_CERTIFICATE_BUNDLE=y
CONFIG_MBEDTLS_CERTIFICATE_BUNDLE_DEFAULT_FULL=y
CONFIG_ESP32S3_SPIRAM_SUPPORT=y
CONFIG_SPIRAM_MODE_OCT=y
CONFIG_SPIRAM_SPEED_80M=y
CONFIG_SPIRAM_TYPE_ESP32S3=y
CONFIG_SPIRAM_SIZE=8388608
CONFIG_SPIRAM_USE_MALLOC=1
CONFIG_SPIRAM_MALLOC_ALWAYSINTERNAL=4096

# CONFIG_ESP_WIFI_STA_DISCONNECTED_PM_ENABLE is not set
```
